## conf/machine/iota.conf
```bitbake
#@TYPE: Machine
#@NAME: Emlid Iota
#@DESCRIPTION: Machine configuration for emlid iota board based on allwinner H5 CPU

require conf/machine/include/sun50i.inc

PREFERRED_VERSION_linux = "4.13+git%"
PREFERRED_VERSION_u-boot = "v2017.09%"

KERNEL_DEVICETREE = "${MANUFACTURER}/sun50i-h5-emlid-iota.dtb \
                     ${MANUFACTURER}/overlay/sun50i-h5-analog-codec.dtbo \
                     ${MANUFACTURER}/overlay/sun50i-h5-cir.dtbo \
                     ${MANUFACTURER}/overlay/sun50i-h5-spi-spidev0.dtbo \
                     ${MANUFACTURER}/overlay/sun50i-h5-spi-spidev1.dtbo \
                     ${MANUFACTURER}/overlay/sun50i-h5-uart1.dtbo \
                     ${MANUFACTURER}/overlay/sun50i-h5-uart2.dtbo \
                     ${MANUFACTURER}/overlay/sun50i-h5-uart3.dtbo \
                     ${MANUFACTURER}/overlay/sun50i-h5-i2c0.dtbo \
                     ${MANUFACTURER}/overlay/sun50i-h5-i2c1.dtbo \
                     ${MANUFACTURER}/overlay/sun50i-h5-i2c2.dtbo \
                     ${MANUFACTURER}/overlay/sun50i-h5-usbhost0.dtbo \
                     ${MANUFACTURER}/overlay/sun50i-h5-usbhost1.dtbo \
                     ${MANUFACTURER}/overlay/sun50i-h5-usbhost2.dtbo \
                     ${MANUFACTURER}/overlay/sun50i-h5-usbhost3.dtbo \
                    "
UBOOT_MACHINE = "emlid_iota_defconfig"

DEFAULTTUNE = "aarch64"
```

## meta-iota-bsp/conf/machine/iota.conf
```bitbake
#@TYPE: Machine
#@NAME: Emlid Iota
#@DESCRIPTION: Machine configuration for emlid iota board based on allwinner H5 CPU

require conf/machine/include/sun50i.inc

PREFERRED_VERSION_linux = "4.14+git%"
PREFERRED_VERSION_u-boot = "v2018.01%"

KERNEL_DEVICETREE = "${MANUFACTURER}/sun50i-h5-emlid-iota.dtb \
                     ${MANUFACTURER}/overlay/sun50i-h5-analog-codec.dtbo \
                     ${MANUFACTURER}/overlay/sun50i-h5-cir.dtbo \
                     ${MANUFACTURER}/overlay/sun50i-h5-spi0-status-okay.dtbo \
                     ${MANUFACTURER}/overlay/sun50i-h5-spi1-status-okay.dtbo \
                     ${MANUFACTURER}/overlay/sun50i-h5-uart1.dtbo \
                     ${MANUFACTURER}/overlay/sun50i-h5-uart2.dtbo \
                     ${MANUFACTURER}/overlay/sun50i-h5-uart3.dtbo \
                     ${MANUFACTURER}/overlay/sun50i-h5-r-uart.dtbo \
                     ${MANUFACTURER}/overlay/sun50i-h5-i2c0.dtbo \
                     ${MANUFACTURER}/overlay/sun50i-h5-i2c1.dtbo \
                     ${MANUFACTURER}/overlay/sun50i-h5-i2c2.dtbo \
                     ${MANUFACTURER}/overlay/sun50i-h5-r-i2c.dtbo \
                     ${MANUFACTURER}/overlay/sun50i-h5-usbhost0.dtbo \
                     ${MANUFACTURER}/overlay/sun50i-h5-usbhost1.dtbo \
                     ${MANUFACTURER}/overlay/sun50i-h5-usbhost2.dtbo \
                     ${MANUFACTURER}/overlay/sun50i-h5-usbhost3.dtbo \
                    "
UBOOT_MACHINE = "emlid_iota_defconfig"

DEFAULTTUNE = "aarch64"

KERNEL_MODULE_AUTOLOAD += "g_cdc"
module_conf_g_cdc = "options g_cdc idVendor=0x1861 idProduct=0x2017 iProduct=Iota iManufacturer=Emlid"

KERNEL_MODULE_PROBECONF += "g_cdc"
```

## meta-iota-distro/conf/bblayers.conf.sample
```bitbake
# POKY_BBLAYERS_CONF_VERSION is increased each time build/conf/bblayers.conf
# changes incompatibly
POKY_BBLAYERS_CONF_VERSION = "2"

BBPATH = "${TOPDIR}"
BBFILES ?= ""

BBLAYERS ?= " \
  /data/alex/iota/yocto_pyro_2.3/poky/meta \
  /data/alex/iota/yocto_pyro_2.3/poky/meta-poky \
  /data/alex/iota/yocto_pyro_2.3/poky/meta-yocto-bsp \
  /data/alex/iota/yocto_pyro_2.3/poky/meta-sunxi \
  /data/alex/iota/yocto_pyro_2.3/poky/meta-iota/meta-iota-bsp \
  /data/alex/iota/yocto_pyro_2.3/poky/meta-iota/meta-iota-distro \
  /data/alex/iota/yocto_pyro_2.3/poky/meta-openembedded/meta-oe \
  /data/alex/iota/yocto_pyro_2.3/poky/meta-openembedded/meta-networking \
  /data/alex/iota/yocto_pyro_2.3/poky/meta-openembedded/meta-webserver \
  /data/alex/iota/yocto_pyro_2.3/poky/meta-openembedded/meta-python \
  /data/alex/iota/yocto_pyro_2.3/poky/meta-openembedded/meta-systemd \
  "
```

## meta-iota-distro/conf/distro/poky-iota.conf
```bitbake
require conf/distro/poky.conf

POKY_VERSION := "${DISTRO_VERSION}"
DISTRO = "poky-iota"
DISTRO_NAME = "Poky Iota (Emlid Iota Linux Distro)"
DISTRO_VERSION = "0.1.3-dev"

DISTRO_FEATURES += "systemd sysvinit"

VIRTUAL-RUNTIME_init_manager = "systemd"
VIRTUAL-RUNTIME_initscripts = ""
```

## meta-neutis-bsp/conf/layer.conf
```bitbake
# We have a conf and classes directory, append to BBPATH
BBPATH .= ":${LAYERDIR}"

# We have a recipes directory, add to BBFILES
BBFILES += "${LAYERDIR}/recipes*/*/*.bb ${LAYERDIR}/recipes*/*/*.bbappend"

BBFILE_COLLECTIONS += "meta-neutis-bsp"
BBFILE_PATTERN_meta-neutis-bsp := "^${LAYERDIR}/"
BBFILE_PRIORITY_meta-neutis-bsp = "10"

LAYERSERIES_COMPAT_meta-neutis-bsp = "sumo"
```

## meta-neutis-bsp/conf/machine/neutis-n5.conf
```bitbake
#@TYPE: Machine
#@NAME: Emlid Neutis N5
#@DESCRIPTION: Machine configuration for Emlid Neutis N5 board based on Allwinner H5 CPU

require conf/machine/include/sun50i.inc

PREFERRED_PROVIDER_virtual/kernel = "linux-sunxi"

MANUFACTURER = "allwinner"

PREFERRED_VERSION_linux = "4.17+git%"
PREFERRED_VERSION_u-boot = "v2018.07%"

KERNEL_DEVICETREE = "${MANUFACTURER}/sun50i-h5-emlid-neutis-n5.dtb \
                     ${MANUFACTURER}/sun50i-h5-emlid-neutis-n5-devboard.dtb \
                     ${MANUFACTURER}/overlay/sun50i-h5-analog-codec.dtbo \
                     ${MANUFACTURER}/overlay/sun50i-h5-cir.dtbo \
                     ${MANUFACTURER}/overlay/sun50i-h5-ethernet-100.dtbo \
                     ${MANUFACTURER}/overlay/sun50i-h5-spi0-status-okay.dtbo \
                     ${MANUFACTURER}/overlay/sun50i-h5-spi1-status-okay.dtbo \
                     ${MANUFACTURER}/overlay/sun50i-h5-uart1.dtbo \
                     ${MANUFACTURER}/overlay/sun50i-h5-uart2.dtbo \
                     ${MANUFACTURER}/overlay/sun50i-h5-uart3.dtbo \
                     ${MANUFACTURER}/overlay/sun50i-h5-r-uart.dtbo \
                     ${MANUFACTURER}/overlay/sun50i-h5-i2c0.dtbo \
                     ${MANUFACTURER}/overlay/sun50i-h5-i2c1.dtbo \
                     ${MANUFACTURER}/overlay/sun50i-h5-i2c2.dtbo \
                     ${MANUFACTURER}/overlay/sun50i-h5-r-i2c.dtbo \
                     ${MANUFACTURER}/overlay/sun50i-h5-usbhost0.dtbo \
                     ${MANUFACTURER}/overlay/sun50i-h5-usbhost1.dtbo \
                     ${MANUFACTURER}/overlay/sun50i-h5-usbhost2.dtbo \
                     ${MANUFACTURER}/overlay/sun50i-h5-usbhost3.dtbo \
                     ${MANUFACTURER}/overlay/sun50i-h5-hdmi.dtbo \
                     ${MANUFACTURER}/overlay/sun50i-h5-camera-status-okay.dtbo \
                    "
UBOOT_MACHINE = "emlid_neutis_n5_defconfig"

DEFAULTTUNE = "aarch64"

KERNEL_MODULE_AUTOLOAD += "g_cdc"
module_conf_g_cdc = "options g_cdc idVendor=0x3032 idProduct=0x0001 iProduct=Neutis_N5 iManufacturer=Emlid"

KERNEL_MODULE_PROBECONF += "g_cdc"
```

## meta-neutis-distro/conf/bblayers.conf.sample
```bitbake
# POKY_BBLAYERS_CONF_VERSION is increased each time build/conf/bblayers.conf
# changes incompatibly
POKY_BBLAYERS_CONF_VERSION = "2"

BBPATH = "${TOPDIR}"
BBFILES ?= ""

BBLAYERS ?= " \
  !LAYERS_ROOT!/meta \
  !LAYERS_ROOT!/meta-poky \
  !LAYERS_ROOT!/meta-yocto-bsp \
  !LAYERS_ROOT!/meta-sunxi \
  !LAYERS_ROOT!/meta-emlid-neutis/meta-neutis-bsp \
  !LAYERS_ROOT!/meta-emlid-neutis/meta-neutis-distro \
  !LAYERS_ROOT!/meta-openembedded/meta-oe \
  !LAYERS_ROOT!/meta-openembedded/meta-networking \
  !LAYERS_ROOT!/meta-openembedded/meta-webserver \
  !LAYERS_ROOT!/meta-openembedded/meta-python \
  "
```

## meta-neutis-distro/conf/distro/poky-neutis-mender.conf
```bitbake
require poky-neutis.conf

DISTRO = "poky-neutis-mender"

INHERIT += "mender-full"
MENDER_ARTIFACT_NAME = "release-1"
MENDER_FEATURES_ENABLE_append = " mender-uboot"

MENDER_STORAGE_DEVICE = "/dev/mmcblk2"

MENDER_IMAGE_BOOTLOADER_FILE = "u-boot-sunxi-with-spl.bin"
IMAGE_BOOT_FILES_append = " boot.scr"
ARTIFACTIMG_FSTYPE = "ext4"
IMAGE_OVERHEAD_FACTOR = "1.0"
IMAGE_FSTYPES = "sdimg"

MENDER_STORAGE_TOTAL_SIZE_MB = "1600"
MENDER_UBOOT_STORAGE_DEVICE = "1"
MENDER_IMAGE_BOOTLOADER_BOOTSECTOR_OFFSET = "16"

MENDER_FEATURES_ENABLE_append = " mender-uboot mender-image-sd"
MENDER_FEATURES_DISABLE_append = " mender-grub mender-image-uefi"
```

## meta-neutis-distro/conf/distro/poky-neutis.conf
```bitbake
require conf/distro/poky.conf

POKY_VERSION := "${DISTRO_VERSION}"
DISTRO = "poky-neutis"
DISTRO_NAME = "Poky Neutis (Emlid Neutis Linux Distro)"
DISTRO_VERSION = "${NEUTIS_DISTRO_VERSION}"

DISTRO_FEATURES += "systemd sysvinit"
INITRAMFS_IMAGE = "core-image-minimal-initramfs"

VIRTUAL-RUNTIME_init_manager = "systemd"
VIRTUAL-RUNTIME_initscripts = ""
```

## meta-neutis-distro/conf/layer.conf
```bitbake
# We have a conf and classes directory, append to BBPATH
BBPATH .= ":${LAYERDIR}"

# We have a recipes directory, add to BBFILES
BBFILES += "${LAYERDIR}/recipes*/*/*.bb ${LAYERDIR}/recipes*/*/*.bbappend"

BBFILE_COLLECTIONS += "meta-neutis-distro"
BBFILE_PATTERN_meta-neutis-distro := "^${LAYERDIR}/"
BBFILE_PRIORITY_meta-neutis-distro = "10"

LAYERSERIES_COMPAT_meta-neutis-distro = "sumo"
```
